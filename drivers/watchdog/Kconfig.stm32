## drivers/watchdog/Kconfig.stm32
```kconfig
# STM32 IWDG configuration

# Copyright (c) 2016 Open-RnD Sp. z o.o.
# Copyright (c) 2017 RnDity Sp. z o.o.
# Copyright (c) 2019 Centaur Analytics, Inc
# SPDX-License-Identifier: Apache-2.0

menuconfig IWDG_STM32
	bool "Independent Watchdog (IWDG) Driver for STM32 family of MCUs"
	default y
	depends on DT_HAS_ST_STM32_WATCHDOG_ENABLED
	select HAS_WDT_DISABLE_AT_BOOT
	select HAS_WDT_NO_CALLBACKS
	help
	  Enable IWDG driver for STM32 line of MCUs

choice IWDG_STM32_STANDBY
	prompt "IWDG behavior in standby mode"
	depends on IWDG_STM32
	default IWDG_STM32_STANDBY_NO_CHANGE
	help
	  Configure whether the IWDG runs during standby mode.
	  This modifies the IWDG_STDBY option byte if needed.
	  Selecting "no change" leaves the option byte as-is.

config IWDG_STM32_STANDBY_NO_CHANGE
	bool "No change"
	help
	  Do not modify the IWDG_STDBY option byte.

config IWDG_STM32_STANDBY_FREEZE
	bool "Freeze IWDG in standby"
	select FLASH_STM32_OPTION_BYTES
	select FLASH_EX_OP_ENABLED
	help
	  Clear the IWDG_STDBY option byte so the IWDG is frozen
	  during standby mode. Prevents spurious watchdog resets
	  when the system enters low-power standby.

config IWDG_STM32_STANDBY_ACTIVE
	bool "IWDG active in standby"
	select FLASH_STM32_OPTION_BYTES
	select FLASH_EX_OP_ENABLED
	help
	  Set the IWDG_STDBY option byte so the IWDG continues
	  running during standby mode.

endchoice

config IWDG_STM32_STANDBY_INIT_PRIORITY
	int "IWDG standby configuration init priority"
	depends on IWDG_STM32_STANDBY_FREEZE || IWDG_STM32_STANDBY_ACTIVE
	default 85
	help
	  Initialization priority for the IWDG standby option byte
	  configuration. It must be greater than FLASH_INIT_PRIORITY
	  to ensure the flash driver is available for option byte access.

config IWDG_STM32_INITIAL_TIMEOUT
	int "Value for IWDG timeout in ms"
	depends on IWDG_STM32
	default 100
	range 1 26214
	help
	  Set initial timeout value for IWDG in ms if enabled at boot.

	  The min timeout supported is 1 ms. The max timeout depends on the
	  MCU's LSI clock frequency and can be calculated with:

	    max. prescaler value (256) * max. reload ticks (4096) / LSI freq.

	  Limiting maximum timeout to a safe value of 26214 ms here, which was
	  calculated for highest LSI frequency among STM32 MCUs of 40 kHz.

config WWDG_STM32
	bool "System Window Watchdog (WWDG) Driver for STM32 family of MCUs"
	default y
	depends on DT_HAS_ST_STM32_WINDOW_WATCHDOG_ENABLED
	help
	  Enable WWDG driver for STM32 line of MCUs
```
